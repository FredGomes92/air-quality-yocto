## meta-air-quality/conf/distro/air-quality.conf
```bitbake
# Custom distro for air quality project
DISTRO = "air-quality"
DISTRO_NAME = "Air Quality Distro"
DISTRO_VERSION = "1.0"

# Use Poky as a base
include conf/distro/poky.conf

# Package format
PACKAGE_CLASSES = "package_deb"

# Init system
VIRTUAL-RUNTIME_init_manager = "systemd"
DISTRO_FEATURES:append = " systemd"

IMAGE_INSTALL:append = " sensor-temp flask-web sensor-pms5003"
IMAGE_INSTALL:append = " \
    linux-firmware \
"
# IMAGE_INSTALL:append = " \
#     linux-firmware \
#     wpa-supplicant \
#     iw \
#     wireguard-tools \
#     connman \
#     connman-client \
# "

# WIFI_SSID = "Proximus-Home-261468"
# WIFI_PSK = "yjks2nu57nka3swp"

# CONFIG_DUMP_OBSS=n
#ptional: disable Bluetooth to avoid UART conflict
RPI_EXTRA_CONFIG += "dtoverlay=disable-bt\n"
RPI_EXTRA_CONFIG += "enable_uart=1\n"
RPI_EXTRA_CONFIG += "dtoverlay=uart0\n"
# Ensure kernel driver autoload
# KERNEL_MODULE_AUTOLOAD:append = " brcmfmac"
##########################################

IMAGE_FSTYPES += "wic"
INIT_MANAGER = "systemd"

APPEND += " rootwait loglevel=7"

# Add nodejs for node-red
IMAGE_INSTALL:append = " paho-mqtt-cpp mosquitto mosquitto-clients python3-pytz"
IMAGE_INSTALL:append = " picocom"

# Enable SSH server
IMAGE_INSTALL:append = " dropbear"

# Enable I2C
ENABLE_I2C="1"
IMAGE_INSTALL:append = " i2c-tools kernel-modules"
RPI_EXTRA_CONFIG:append = " dtparam=i2c_arm=on"
KERNEL_MODULE_AUTOLOAD:append = " i2c-dev"

# BB_NUMBER_THREADS = "4"
# PARALLEL_MAKE = "-j4"
```

## meta-air-quality/conf/layer.conf
```bitbake
# We have a conf and classes directory, add to BBPATH
BBPATH .= ":${LAYERDIR}"

# We have recipes-* directories, add to BBFILES
BBFILES += "${LAYERDIR}/recipes-*/*/*.bb \
            ${LAYERDIR}/recipes-*/*/*.bbappend"

BBFILE_COLLECTIONS += "meta-air-quality"
BBFILE_PATTERN_meta-air-quality = "^${LAYERDIR}/"
BBFILE_PRIORITY_meta-air-quality = "6"

LAYERDEPENDS_meta-air-quality = "core"
LAYERSERIES_COMPAT_meta-air-quality = "styhead"
```
